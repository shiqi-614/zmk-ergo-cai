## Kconfig
```kconfig
menuconfig ANALOG_INPUT
	bool "ANALOG_INPUT adc sensor"
  select ADC
	help
	  Enable ANALOG_INPUT adc sensor.

if ANALOG_INPUT

config ANALOG_INPUT_USE_DTS_ADC_CH_CFG
		bool "Use per adc channel config from device tree"
		help
			Enable this to passthrow adc channel to chanel setup, 
			otherwise use default favor.
			(ADC_GAIN_1_6, ADC_REF_INTERNAL, ADC_ACQ_TIME_DEFAULT)

config ANALOG_INPUT_ADC_RES
		int "ADC Channels Resolution (Bit)"
		default 12
		help
			Resolution of ADC Channel. Default 12 bit, up to 32 bit.
			Used to setup buffer size of ADC sequencer of all channels.

config ANALOG_INPUT_WORKQUEUE_PRIORITY
    int "Workqueue priority"
    default 10
    help
      Priority of thread used by the workqueue

config ANALOG_INPUT_WORKQUEUE_STACK_SIZE
    int "Workqueue stack size"
    default 1024
    help
      Stack size of thread used by the workqueue

config ANALOG_INPUT_REPORT_INTERVAL_MIN
	int "ANALOG_INPUT's default minimum report rate"
	default 0
	help
	  Default minimum report interval in milliseconds.
		Slow down input reporting for hid queue over the air.

config ANALOG_INPUT_LOG_DBG_RAW
	bool "ANALOG_INPUT debug log for RAW mV"

config ANALOG_INPUT_LOG_DBG_REPORT
	bool "ANALOG_INPUT debug log for REPORT value"

module = ANALOG_INPUT
module-str = ANALOG_INPUT
source "${ZEPHYR_BASE}/subsys/logging/Kconfig.template.log_config"

endif #ANALOG_INPUT

config ZMK_LAYER_COLOR_LED
	bool "Show the highest active layer as a colour on an LED strip"
	default y
	depends on DT_HAS_ZMK_LAYER_COLOR_LED_ENABLED
	depends on !ZMK_SPLIT || ZMK_SPLIT_ROLE_CENTRAL
	select LED_STRIP
	help
	  Lights the led-strip of the zmk,layer-color-led node in the colour its
	  colors property gives the highest active layer. Only the half that runs
	  the keymap knows the layer, so a split's peripheral leaves it out.

config ZMK_LAYER_COLOR_LED_OFF_IDLE
	bool "Turn the layer colour LED off while the keyboard is idle"
	default y
	depends on ZMK_LAYER_COLOR_LED

config ZMK_POGO_DETECT
	bool "Start the joystick or the trackball module on the joystick mount, whichever sits on it"
	depends on SPI && REGULATOR && PM_DEVICE
	help
	  With the pogo_detect shield after the joystick and trackball shields: at boot, probe the
	  mount for a PMW3610 and start that module's devices, which the shield defers.
```

## dts/bindings/zmk,layer-color-led.yaml
```yaml
description: |
  Shows the keymap's highest active layer as a colour on an LED strip: every LED of the strip
  takes the colour that `colors` gives the layer. The LEDs are off for layers past the end of
  the list, while the keyboard sleeps, and while it is idle (CONFIG_ZMK_LAYER_COLOR_LED_OFF_IDLE).
  Only the half that runs the keymap knows the layer; on a split that is the central.

    layer_led: layer_color_led {
        compatible = "zmk,layer-color-led";
        led-strip = <&status_led>;
        colors = <0x000000 0x000020 0x002000>;  /* layer 0 off, 1 blue, 2 green */
    };

compatible: "zmk,layer-color-led"

properties:
  led-strip:
    type: phandle
    required: true
    description: The LED strip that shows the layer, e.g. a worldsemi,ws2812-spi node.

  colors:
    type: array
    required: true
    description: |
      The colour of each layer as 0xRRGGBB, by layer index in keymap order; 0x000000 is off.
      An indicator needs a fraction of full brightness: about 0x20 per channel.
```
