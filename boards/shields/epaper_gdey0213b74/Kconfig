## boards/shields/epaper_gdey0213b74/Kconfig
```kconfig
config SHIELD_EPAPER_GDEY0213B74
    bool

config EPAPER_GDEY0213B74
    bool "Enable epaper_gdey0213b74"
    # 这里可以定义依赖，比如依赖某个驱动或显示框架
```

## boards/shields/epaper_gdey0213b74/Kconfig.defconfig
```kconfig
if SHIELD_EPAPER_GDEY0213B74
config EPAPER_GDEY0213B74
    bool "Enable epaper_gdey0213b74"
    default y
endif 
```

## boards/shields/epaper_gdey0213b74/Kconfig.shield
```kconfig
config SHIELD_EPAPER_GDEY0213B74
    def_bool $(shields_list_contains,epaper_gdey0213b74)
```

## boards/shields/joystick/Kconfig
```kconfig
config SHIELD_JOYSTICK
    bool

config JOYSTICK
    bool "Enable joystick"
    select ANALOG_INPUT  # 如果勾选 JOYSTICK 自动开启 ANALOG_INPUT 驱动

menuconfig ANALOG_INPUT
    bool "ANALOG_INPUT adc sensor"
    select ADC
    select INPUT
    help
      Enable ANALOG_INPUT adc sensor.

if ANALOG_INPUT

config ANALOG_INPUT_USE_DTS_ADC_CH_CFG
    bool "Use per adc channel config from device tree"
    help
      Enable this to passthrow adc channel to chanel setup, 
      otherwise use default favor.
      (ADC_GAIN_1_6, ADC_REF_INTERNAL, ADC_ACQ_TIME_DEFAULT)

config ANALOG_INPUT_ADC_RES
    int "ADC Channels Resolution (Bit)"
    default 12
    help
      Resolution of ADC Channel. Default 12 bit, up to 32 bit.
      Used to setup buffer size of ADC sequencer of all channels.

config ANALOG_INPUT_WORKQUEUE_PRIORITY
    int "Workqueue priority"
    default 10
    help
      Priority of thread used by the workqueue.

config ANALOG_INPUT_WORKQUEUE_STACK_SIZE
    int "Workqueue stack size"
    default 1024
    help
      Stack size of thread used by the workqueue.

config ANALOG_INPUT_REPORT_INTERVAL_MIN
    int "ANALOG_INPUT's default minimum report rate"
    default 0
    help
      Default minimum report interval in milliseconds.
      Slow down input reporting for hid queue over the air.

config ANALOG_INPUT_LOG_DBG_RAW
    bool "ANALOG_INPUT debug log for RAW mV"

config ANALOG_INPUT_LOG_DBG_REPORT
    bool "ANALOG_INPUT debug log for REPORT value"

# 动态生成 CONFIG_ANALOG_INPUT_LOG_LEVEL
module = ANALOG_INPUT
module-str = analog_input
source "subsys/logging/Kconfig.template.log_config"

endif # ANALOG_INPUT
```

## boards/shields/joystick/Kconfig.defconfig
```kconfig
if SHIELD_JOYSTICK
config JOYSTICK
    bool "Enable joystick"
    default y

config ANALOG_INPUT
    default y

endif 
```

## dts/bindings/zmk,analog-input.yaml
```yaml
# Copyright (c) 2022 The ZMK Contributors
# SPDX-License-Identifier: MIT
description: |
  Input driver for ADC io channel

compatible: "zmk,analog-input"

properties:
  sampling-hz:
    type: int
    default: 100

  power-gpios:
    type: phandle-array
    description: "GPIO pin used to power the analog joystick (turns off during Deep Sleep)"

  idle-sampling-hz:
    type: int
    default: 10
    description: "Sampling frequency in Hz when joystick is in idle state"

  idle-timeout-ms:
    type: int
    default: 3000
    description: "Inactivity duration in ms before dropping to idle-sampling-hz"

child-binding:
  description: Per-channel configuration settings
  properties:
    io-channels:
      type: phandle-array
      required: true
    mv-min-max:
      type: int
      required: true
    mv-deadzone:
      type: int
      default: 10
    invert:
      type: boolean
    report-on-change-only:
      type: boolean
    scale-multiplier:
      type: int
      default: 1
    scale-divisor:
      type: int
      default: 70
    evt-type:
      type: int
      required: true
    input-code:
      type: int
      required: true
```
